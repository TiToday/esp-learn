## soil_moisture/components/aliyun_mqtt/Kconfig
```kconfig
menu "AliYun MQTT Component Configuration"

config AliYun_MQTT_HOST_URL
    string "AliYun MQTT Host URL"
    default "mqtt://a1aQnNiu9ZS.iot-as-mqtt.cn-shanghai.aliyuncs.com:1883"
    help
      Specify the AliYun MQTT server URL. Adjust as per your AliYun IoT Platform setup.

config AliYun_MQTT_PORT
    int "AliYun MQTT Port"
    default 1883
    help
      MQTT port for connecting to AliYun IoT Platform. Change only if your AliYun service uses a different port.

config AliYun_MQTT_CLIENT_ID
    string "AliYun MQTT Client ID"
    default "a1aQnNiu9ZS.soil_moisture|securemode=2,signmethod=hmacsha256,timestamp=1726143693895|"
    help
      Unique client identifier for AliYun MQTT connection. Customize according to your device and AliYun's security requirements.

config AliYun_MQTT_USERNAME
    string "AliYun MQTT Username"
    default "soil_moisture&a1aQnNiu9ZS"
    help
      Username for AliYun MQTT authentication. Use the credentials provided by AliYun for your device.

config AliYun_MQTT_PASSWORD
    string "AliYun MQTT Password"
    default "016978672b45aecbd0eda6df7e5582931834139b4de8e4519f714a19edc8dee5"
    help
      Password for AliYun MQTT authentication. Ensure to use the secure access key assigned by AliYun for your device.

config AliYun_PUBLISH_TOPIC_USER_POST
    string "AliYun Publish Topic for User Post"
    default "/sys/a1aQnNiu9ZS/soil_moisture/thing/event/property/post"
    help
      Default topic for publishing device events to AliYun. Modify if your AliYun service requires a different topic.

config AliYun_SUBSCRIBE_TOPIC_USER_GET
    string "AliYun Subscribe Topic for User Get"
    default "/a1aQnNiu9ZS/soil_moisture/user/get"
    help
      Topic to subscribe for receiving user get requests from AliYun. Adjust if your AliYun service uses a different topic.

config AliYun_PUBLISH_TOPIC_USER_UPDATE
    string "AliYun Publish Topic for User Update"
    default "/a1aQnNiu9ZS/soil_moisture/user/data"
    help
      Topic for sending user updates to AliYun. Customize if your AliYun service has a different topic structure.

config AliYun_PUBLISH_TOPIC_USER_POST_REPLY
    string "AliYun Publish Topic for Device p set"
    default "/sys/a1aQnNiu9ZS/soil_moisture/thing/event/property/post_reply"
    help
      Topic for sending user updates to AliYun. Customize if your AliYun service has a different topic structure.
endmenu
```

## soil_moisture/main/Kconfig.projbuild
```kconfig
menu "Example Configuration"

    # config ESP_WIFI_SSID
    #     string "WiFi SSID"
    #     default "208"
    #     help
    #         SSID (network name) for the example to connect to.

    # config ESP_WIFI_PASSWORD
    #     string "WiFi Password"
    #     default "iot208208208"
    #     help
    #         WiFi password (WPA or WPA2) for the example to use.

    # config ESP_MAXIMUM_RETRY
    #     int "Maximum retry"
    #     default 6
    #     help
    #         Set the Maximum retry to avoid station reconnecting to the AP unlimited when the AP is really inexistent.
            
    config EXAMPLE_WIFI_CONNECTION_MAXIMUM_RETRY
        int "WiFi connection maximum retry"
        range 0 255
        default 2
        help
            WiFi connection maximum retry, from 0 to 255.

endmenu
```

## test_lvgl_2/sdkconfig.defaults
```kconfig
CONFIG_ESPTOOLPY_FLASHSIZE_16MB = y

#
# Demos
#
# CONFIG_LV_USE_DEMO_WIDGETS is not set
# CONFIG_LV_DEMO_WIDGETS_SLIDESHOW is not set
# CONFIG_LV_USE_DEMO_KEYPAD_AND_ENCODER is not set
# CONFIG_LV_USE_DEMO_BENCHMARK is not set
CONFIG_LV_USE_DEMO_STRESS = y
# CONFIG_LV_USE_DEMO_MUSIC is not set
# end of Demos
# end of LVGL configuration
# end of Component config

CONFIG_LV_MEM_SIZE_KILOBYTES=40
CONFIG_LV_COLOR_16_SWAP=y



#
# Enable built-in fonts
#
# CONFIG_LV_FONT_MONTSERRAT_8 is not set
# CONFIG_LV_FONT_MONTSERRAT_10 is not set
# CONFIG_LV_FONT_MONTSERRAT_12 is not set
CONFIG_LV_FONT_MONTSERRAT_14=y
# CONFIG_LV_FONT_MONTSERRAT_16 is not set
# CONFIG_LV_FONT_MONTSERRAT_18 is not set
CONFIG_LV_FONT_MONTSERRAT_20=y
# CONFIG_LV_FONT_MONTSERRAT_22 is not set
# CONFIG_LV_FONT_MONTSERRAT_24 is not set
# CONFIG_LV_FONT_MONTSERRAT_26 is not set
# CONFIG_LV_FONT_MONTSERRAT_28 is not set
# CONFIG_LV_FONT_MONTSERRAT_30 is not set
# CONFIG_LV_FONT_MONTSERRAT_32 is not set
# CONFIG_LV_FONT_MONTSERRAT_34 is not set
# CONFIG_LV_FONT_MONTSERRAT_36 is not set
CONFIG_LV_FONT_MONTSERRAT_38=y
# CONFIG_LV_FONT_MONTSERRAT_40 is not set
# CONFIG_LV_FONT_MONTSERRAT_42 is not set
# CONFIG_LV_FONT_MONTSERRAT_44 is not set
# CONFIG_LV_FONT_MONTSERRAT_46 is not set
# CONFIG_LV_FONT_MONTSERRAT_48 is not set
# CONFIG_LV_FONT_MONTSERRAT_12_SUBPX is not set
# CONFIG_LV_FONT_MONTSERRAT_28_COMPRESSED is not set
# CONFIG_LV_FONT_DEJAVU_16_PERSIAN_HEBREW is not set
# CONFIG_LV_FONT_SIMSUN_16_CJK is not set
# CONFIG_LV_FONT_UNSCII_8 is not set
# CONFIG_LV_FONT_UNSCII_16 is not set
# CONFIG_LV_FONT_CUSTOM is not set
# end of Enable built-in fonts
```
